# Copyright (c) 2021 The ZMK Contributors
# SPDX-License-Identifier: MIT

/ {
      chosen {
         zmk,kscan = &kscan0;
         };
         
         kscan0: kscan_0 {
            compatible = "zmk,kscan-gpio-direct";
            
            label = "KSCAN";
            
            input-gpios
                  = <&gpioa 4 (GPIO_ACTIVE_LOW | GPIO_PULL_UP)>
                  , <&gpioa 5 (GPIO_ACTIVE_LOW | GPIO_PULL_UP)>
                  ;
                  
         };
         
   };
