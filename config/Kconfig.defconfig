## config/Kconfig.defconfig
```kconfig
# Copyright (c) 2021 The ZMK Contributors
# SPDX-License-Identifier: MIT

if SHIELD_ROMAC

config ZMK_KEYBOARD_NAME
   default "romac"
   
endif
```

## config/Kconfig.shield
```kconfig
# Copyright (c) 2021 The ZMK Contributors
# SPDX-License-Identifier: MIT

config SHIELD_ROMAC
   def_bool $(shields_list_contains,romac)
```
