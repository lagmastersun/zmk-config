// Copyright (c) 2021 The ZMK Contributors
// SPDX-License-Identifier: MIT

#include <behaviors.dtsi>
#include <dt-bindings/zmk/keys.h>

/ {
      keymap0: keymap {
         compatible = "zmk,keymap";
         
         default_layer {
            bindings = <
               &kp C_VOLUME_UP
               &kp C_VOLUME_DOWN
               
               >;
         };
         
     };
     
  };
